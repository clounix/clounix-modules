## modules/Kconfig
```kconfig
#
# Clounix device configuration
#

config NET_VENDOR_CLOUNIX
	bool "Clounix devices"
	default y
	depends on PCI
	---help---
	  If you have a network (Ethernet) card belonging to this class, say Y.

	  Note that the answer to this question doesn't directly affect the
	  kernel: saying N will just cause the configurator to skip all
	  the questions about Clounix cards. If you say Y, you will be asked for
	  your specific card in the following questions.

if NET_VENDOR_CLOUNIX

source "drivers/net/ethernet/clounix/src/clx_dev/Kconfig"
source "drivers/net/ethernet/clounix/src/clx_netif/Kconfig"
endif # NET_VENDOR_CLOUNIX
```

## modules/src/clx_dev/Kconfig
```kconfig
#
# Clounix device configuration
#

config CLX_DEV
	tristate "Clounix Dev driver Support"
	default m
	depends on PCI
	---help---
	  This enables the support for the Clounix platform.
```

## modules/src/clx_netif/Kconfig
```kconfig
#
# Clounix device configuration
#

config CLX_NETIF
	tristate "Clounix Netif driver Support"
	default m
	depends on PCI
	---help---
	  This enables the support for the Clounix platform.
```
